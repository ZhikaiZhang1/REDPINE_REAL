/**
 * @file       rsi_dac_example.c
 * @version    1.0
 * @date       12 Augest 2018
 *
 * Copyright(C) Redpine Signals 2016
 * All rights reserved by Redpine Signals.
 *
 * @section License
 * This program should be used on your own responsibility.
 * Redpine Signals assumes no responsibility for any losses
 * incurred by customers or third parties arising from the use of this file.
 *
 * @brief This file contains example describing usage of DAC peripheral testing.
 *
 * @section Description
 * Demonstrate the DAC functionality. 
 */
 
/* Includes ------------------------------------------------------------------*/
#include "rsi_chip.h"
#include "UDMA.h"

/* Private typedef -----------------------------------------------------------*/
extern RSI_DRIVER_UDMA Driver_UDMA1;
static RSI_DRIVER_UDMA *UDMAdrv1 = &Driver_UDMA1;
extern RSI_UDMA_HANDLE_T udmaHandle1;
RSI_UDMA_CHA_CONFIG_DATA_T control;
RSI_UDMA_CHA_CFG_T config;

/* Private macro -------------------------------------------------------------*/
#define  UDMA1_IRQHandler  IRQ010_Handler
#define  ADC_IRQ_Handler   IRQ011_Handler
#define  OUTPUT_PIN_NUMBER  4
#define  OUTPUT_MUX_ENABLE  1
#define  OUTPUT_MUX_SEL     0   /* Select DAC output on ULP_GPIO4 */
#define  DAC_FIFO_THR       4   /* Set FIFO threshold as 4 */
#define  DAC_FIFO_MODE      0
#define  BUFFER_SIZE        1024
/* Private function prototype ---------------------------------------------------------*/  
volatile uint32_t done,ret;
uint16_t out_data_ping[100];
uint16_t out_data_pong[100];
uint16_t tx_buffer[BUFFER_SIZE] __attribute__((at(0x24061000)));   
uint32_t i,j;

/*Standard sin wave samples */
 uint16_t dac_100k_n0dbfs[1024] = {
0x200,
0x222,
0x245,
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0x1DE,
};



/**
 * @brief      This API configure the pin for DAC output.
 * @param[in]  Pin number to use play DAC output on GPIO , (ULP_GPIO4 or ULP_GPIO15)
 * @return     None
 */ 
void dac_output_pin_mux(uint16_t pin_number)
{
	RSI_EGPIO_SetPinMux(EGPIO1,0,pin_number,EGPIO_PIN_MUX_MODE7);
}

/**
 * @brief      UDMA  controller transfer descriptor chain complete callback 
 * @param[in]  event dma transfer events
 * @param[in]  ch    dma channel number
 * @return     None
 */ 
void udmaTransferComplete(uint32_t event, uint8_t ch)
{
  if(event == UDMA_EVENT_XFER_DONE)
  {
    if(ch == 10)
    {
      done = 1;  
    }
  }
} 

/**
 * @brief      UDMA  configuration and enable function. 
 * @param[in]  event : dma transfer events
 * @param[in]  ch    : dma channel number
 * @return     None
 */ 
void UDMA_Write(void)
{
	memset(&control, 0, sizeof(RSI_UDMA_CHA_CONFIG_DATA_T));
	memset(&config, 0, sizeof(RSI_UDMA_CHA_CFG_T));
	
	config.altStruct = 0;
  config.burstReq  = 1;
  config.channelPrioHigh = 0;
  config.periAck = 0;
  config.periphReq = 0;
  config.reqMask = 0;
  config.dmaCh     = 10;
	
	/* Setup source to desination copy for trigger for memory */
	/* Descriptor configurations */	 
	control.transferType       = UDMA_MODE_BASIC;
	control.nextBurst					 = 0;
	control.totalNumOfDMATrans = BUFFER_SIZE -1;
	control.rPower             = ARBSIZE_4;
	control.srcProtCtrl 			 = 0x000;
	control.dstProtCtrl 			 = 0x000;
	control.srcSize            = SRC_SIZE_16;
	control.srcInc             = SRC_INC_16;
	control.dstSize            = DST_SIZE_16;
	control.dstInc             = DST_INC_NONE;
		
   /* Initialise dma */ 
   UDMAdrv1->Initialize();
	
	 /* Configure dma channel */ 
   UDMAdrv1->ChannelConfigure( 10,(uint32_t )tx_buffer, (uint32_t )0x24043810, BUFFER_SIZE, 
                               control, &config, udmaTransferComplete );
   /* Enable dma channel */
   UDMAdrv1->ChannelEnable(10); 	
}

/**
 * @brief  Main program.
 * @param  None
 * @retval None
 */ 
int main(void)
{
	/* At this stage the MICROCONTROLLER clock setting is already configured,
	 * this is done through SystemInit() function which is called from startup
	 * file (startup_rs1xxxx.s) before to branch to application main.
	 * To reconfigure the default setting of SystemInit() function, refer to
	 * system_rs1xxxx.c file
	 */	
	
	SystemCoreClockUpdate();
	
	/* Power gate enable for DAC */
	RSI_DAC_PowerControl(DAC_POWER_ON);
	
	/* Enble the 32mrc clock to DAC */
	RSI_ULPSS_AuxClkConfig(ULPCLK, ENABLE_STATIC_CLK ,ULP_AUX_32MHZ_RC_CLK);
	
	/* Configure the refernce LDO voltage as 2.4v */
  RSI_ADC_AUXLdoConfig(AUX_ADC_DAC_COMP,0,0xb);
	
	/* Write the 1024 digital sample to ULPSS memory */
	for(i = 0; i < 1024; i=i+2)
  {
     *(volatile uint32_t *)(0x24061000 + (j * 4)) = (dac_100k_n0dbfs[i+1] << 16) | (dac_100k_n0dbfs[i]);
     j = j + 1;
  }
   
  /* Configure the ULP_GPIO4 as analog mode for DAC output */
  dac_output_pin_mux(OUTPUT_PIN_NUMBER);	
  
	/* Divide DAC clock */ 
	RSI_DAC_ClkDivFactor(AUX_ADC_DAC_COMP, 16);
	
	/* Configure the DAC in FIFO mode */
	RSI_DAC_Config(AUX_ADC_DAC_COMP,DAC_FIFO_MODE,OUTPUT_MUX_ENABLE,OUTPUT_MUX_SEL);
	
	/* Set the FIFO threshold value */
	RSI_DAC_SetFifoThreshold(AUX_ADC_DAC_COMP,DAC_FIFO_THR);
  
	/* Start the DAC */
	RSI_DAC_Start(AUX_ADC_DAC_COMP,1);
	
	/* Enable the UDMA interrupt */
	NVIC_EnableIRQ(UDMA1_IRQn);
  
	while(1)
	{	
		/* write data to dac data reg through udma*/ 
    UDMA_Write();
 	  /* Enable dma controller */  
    UDMAdrv1->DMAEnable();
	  /* Wait till dma done here external dma fill the DAC input buffer*/
    while(!done);
		
	  done =0;	
   }
}

